## Client/main/Kconfig.projbuild
```kconfig
menu "Door Monitor Configuration"

    config DOOR_WIFI_SSID
        string "WiFi SSID"
        default "MyWiFiNetwork"
        help
            SSID (network name) for the door monitor to connect to.

    config DOOR_WIFI_PASSWORD
        string "WiFi Password"
        default "password123"
        help
            WiFi password (WPA or WPA2) for the door monitor to connect to.

    config DOOR_SERVER_IP
        string "Server IP Address"
        default "192.168.1.100"
        help
            IP address of the TCP server that will receive door status messages.

    config DOOR_SERVER_PORT
        int "Server Port"
        range 1024 65535
        default 8080
        help
            TCP port number of the server that will receive door status messages.

    config DOOR_NTFY_URL
        string "ntfy.sh Topic URL"
        default "https://ntfy.sh/your_unique_topic_here"
        help
            Full URL to your ntfy.sh topic for door notifications.
            Example: https://ntfy.sh/my_door_sensor_2024

    config DOOR_NTFY_PRIORITY
        choice DOOR_NTFY_PRIORITY_CHOICE
            prompt "Notification Priority"
            default DOOR_NTFY_PRIORITY_DEFAULT
            help
                Priority level for ntfy.sh notifications
        
            config DOOR_NTFY_PRIORITY_MIN
                bool "min"
            config DOOR_NTFY_PRIORITY_LOW
                bool "low" 
            config DOOR_NTFY_PRIORITY_DEFAULT
                bool "default"
            config DOOR_NTFY_PRIORITY_HIGH
                bool "high"
            config DOOR_NTFY_PRIORITY_MAX
                bool "max"
        endchoice

    config DOOR_NTFY_PRIORITY_VALUE
        string
        default "min" if DOOR_NTFY_PRIORITY_MIN
        default "low" if DOOR_NTFY_PRIORITY_LOW
        default "default" if DOOR_NTFY_PRIORITY_DEFAULT
        default "high" if DOOR_NTFY_PRIORITY_HIGH
        default "max" if DOOR_NTFY_PRIORITY_MAX

endmenu
```

## Client/sdkconfig.defaults
```kconfig
# Default configuration for Door Monitor
# These values will be used if not configured via menuconfig

# WiFi Configuration (CHANGE THESE BEFORE BUILDING!)
CONFIG_DOOR_WIFI_SSID="CHANGE_ME"
CONFIG_DOOR_WIFI_PASSWORD="CHANGE_ME"

# Server Configuration
CONFIG_DOOR_SERVER_IP="192.168.1.100"
CONFIG_DOOR_SERVER_PORT=8080

# Enable WiFi
CONFIG_ESP32_WIFI_ENABLED=y
```

## sdkconfig.defaults
```kconfig
# Default configuration for Door Monitor
# These values will be used if not configured via menuconfig

# WiFi Configuration (populated from environment variables)
CONFIG_DOOR_WIFI_SSID="[REDACTED]"
CONFIG_DOOR_WIFI_PASSWORD="[REDACTED]"

# Bluetooth Configuration (populated from environment variables)
CONFIG_DOOR_PHONE_BT_MAC="[REDACTED]"

# ntfy.sh Configuration (populated from environment variables)
CONFIG_DOOR_NTFY_URL="https://ntfy.sh/[REDACTED]"
CONFIG_DOOR_NTFY_PRIORITY_DEFAULT=y

# Enable WiFi and HTTP Client
CONFIG_ESP_WIFI_ENABLED=y

# Enable Bluetooth Classic for SPP
CONFIG_BT_ENABLED=y
CONFIG_BT_BLUEDROID_ENABLED=y
CONFIG_BT_CLASSIC_ENABLED=y
CONFIG_BT_SPP_ENABLED=y
CONFIG_BT_CONTROLLER_ENABLED=y
CONFIG_BT_CTRL_BLE_MAX_CONN=0
CONFIG_BT_CTRL_BR_EDR_MAX_ACL_CONN=1
CONFIG_BT_CTRL_BR_EDR_MAX_SYNC_CONN=0

# Fix controller mode - enable Classic BT support
CONFIG_BTDM_CONTROLLER_MODE_BR_EDR_ONLY=y
# CONFIG_BTDM_CONTROLLER_MODE_BLE_ONLY is not set
# CONFIG_BTDM_CONTROLLER_MODE_BTDM is not set

# Enable HTTPS/TLS support
CONFIG_ESP_TLS_USING_MBEDTLS=y
CONFIG_MBEDTLS_CERTIFICATE_BUNDLE=y
CONFIG_MBEDTLS_CERTIFICATE_BUNDLE_DEFAULT_FULL=y

# Memory optimizations to reduce IRAM usage
CONFIG_LOG_DEFAULT_LEVEL_INFO=y

# Enable debug logging for Bluetooth components
CONFIG_LOG_MAXIMUM_LEVEL=4
CONFIG_BT_LOG_LEVEL_DEBUG=y
CONFIG_BTDM_LOG_LEVEL_DEBUG=y
CONFIG_COMPILER_OPTIMIZATION_SIZE=y
CONFIG_FREERTOS_PLACE_FUNCTIONS_INTO_FLASH=y
CONFIG_SPI_FLASH_DANGEROUS_WRITE_ABORTS=n
CONFIG_SPI_FLASH_YIELD_DURING_ERASE=y
CONFIG_LWIP_SO_REUSE=n
CONFIG_LWIP_NETIF_LOOPBACK=n
CONFIG_LWIP_TCP_MSS=1436

# Disable unused features to save IRAM
CONFIG_ESP_GDBSTUB_SUPPORT_TASKS=n
CONFIG_ESP_GDBSTUB_ENABLED=n
CONFIG_FREERTOS_USE_TRACE_FACILITY=n
CONFIG_FREERTOS_GENERATE_RUN_TIME_STATS=n
CONFIG_ESP_TASK_WDT_EN=n
CONFIG_ESP_INT_WDT_EN=n
CONFIG_MBEDTLS_HARDWARE_AES=n
CONFIG_MBEDTLS_HARDWARE_SHA=n
CONFIG_LIBC_NEWLIB_NANO_FORMAT=y

# Increase app partition size to fit the binary
CONFIG_PARTITION_TABLE_SINGLE_APP_LARGE=y
```
